## zmk-config/choco/Kconfig.shield
```kconfig
# Copyright (c) 2020 Pete Johanson
# SPDX-License-Identifier: MIT

config SHIELD_CHOCO_LEFT
    def_bool $(shields_list_contains,choco_left)

config SHIELD_CHOCO_RIGHT
    def_bool $(shields_list_contains,choco_right)

config SHIELD_CHOCO_DONGLE
    def_bool $(shields_list_contains,choco_dongle)
```
